VERSION ""

NS_ :

BS_:

BU_: ECU

BO_ 2566848770 OtherPG: 8 ECU
 SG_ W : 8|8@1+ (1,0) [0|255] "" ECU

BO_ 2566848769 J1939PG: 8 ECU
 SG_ V : 0|8@1+ (1,0) [0|255] "" ECU
